## examples/focserial/Kconfig
```kconfig
#
# For a description of the syntax of this configuration file,
# see the file kconfig-language.txt in the NuttX tools repository.
#

config EXAMPLES_FOCSERIAL
	tristate "FOC slave example"
	default n
	---help---
		Enable the FOC slave example

if EXAMPLES_FOCSERIAL

config EXAMPLES_FOCSERIAL_PROGNAME
	string "Program name"
	default "focserial"
	---help---
		This is the name of the program that will be used when the NSH ELF
		program is installed.

config EXAMPLES_FOCSERIAL_PRIORITY
	int "FOC slave task priority"
	default 100

config EXAMPLES_FOCSERIAL_STACKSIZE
	int "FOC slave stack size"
	default DEFAULT_TASK_STACKSIZE

config EXAMPLES_FOCSERIAL_SERIAL_DEVPATH
	string "FOC slave serial devpath"
	default "/dev/ttyS1"

config EXAMPLES_FOCSERIAL_FOC_DEVPATH
	string "FOC slave FOC devpath"
	default "/dev/foc"

config EXAMPLES_FOCSERIAL_PWM_FREQ
	int "FOC slave PWM frequency"
	default 10000
	---help---
		Select the FOC PWM switching frequency

config EXAMPLES_FOCSERIAL_NOTIFIER_FREQ
	int "FOC slave notifier frequency"
	default EXAMPLES_FOCSERIAL_PWM_FREQ
	---help---
		Select the FOC notifier frequency

endif
```

## industry/s2opc/Kconfig
```kconfig
menuconfig INDUSTRY_S2OPC
	bool "S2OPC support"
	default n
	---help---
		Enable the S2OPC build

if INDUSTRY_S2OPC

config CANUTILS_S2OPC_URL
	string "URL where S2OPC can be downloaded"
	default "https://gitlab.com/systerel/S2OPC/-/archive/master/"

config CANUTILS_S2OPC_VERSION
	string "Version number"
	default "a2ecf70b76a42c25c5338d86e85250bf16fd7023"

menu "S2OPC configuration"

endmenu # "S2OPC tools"

endif # INDUSTRY_S2OPC
```

## logging/nxscope/sensors/Kconfig
```kconfig
#
# For a description of the syntax of this configuration file,
# see the file kconfig-language.txt in the NuttX tools repository.
#

menuconfig NXSCOPE_SENSORS
	bool "NxScope sensros app"
	default n
	select LOGGING_NXSCOPE_INTF_SERIAL
	select LOGGING_NXSCOPE_PROTO_SER

if NXSCOPE_SENSORS

config NXSCOPE_SENSORS_PROGNAME
	string "Program name"
	default "nxscope"

config NXSCOPE_SENSORS_PRIORITY
	int "nxscope task priority"
	default 100

config NXSCOPE_SENSORS_STACKSIZE
	int "nxscope stack size"
	default DEFAULT_TASK_STACKSIZE

config NXSCOPE_SENSORS_SERIAL_PATH
	string "nxscope serial path"
	default "/dev/ttyUSB0"

config NXSCOPE_SENSORS_SERIAL_BAUD
	int "nxscope serial baud"
	default 115200
	---help---
		Ignored if set to 0 (for example for RTT interface)

config NXSCOPE_SENSORS_CDCACM
	bool "nxscope CDCACM device support"
	depends on CDCACM
	default n

config NXSCOPE_SENSORS_FORCE_ENABLE
	bool "nxscope force enable"
	default n

config NXSCOPE_SENSORS_STREAMBUF_LEN
	int "nxscope stream buffer length"
	default 512

config NXSCOPE_SENSORS_RXBUF_LEN
	int "nxscope RX buffer length"
	default 32

config NXSCOPE_SENSORS_RX_PADDING
	int "nxscope RX padding"
	default 0

config NXSCOPE_SENSORS_MAIN_INTERVAL
	int "nxscope main interval (microseconds)"
	default 100000
	---help---
		This value is responsible for the frequency at which stream
		frames will be sent and incoming frames will be received.

config NXSCOPE_SENSORS_FETCH_INTERVAL
	int "nxscope sensor fetch interval (microseconds)"
	default 1000
	---help---
		This value is responsible for the frequency at which the sensors
		are read

endif # NXSCOPE_SENSORS
```

## mgmt/mcumgr/Kconfig
```kconfig
#
# For a description of the syntax of this configuration file,
# see the file kconfig-language.txt in the NuttX tools repository.
#

menuconfig MGMT_MCUMGR
	bool "MCUmgr support"
	default n
	depends on FSUTILS_ZCBOR
	---help---
		Enable support for MCUmgr

if MGMT_MCUMGR

config MGMT_MCUMGR_DAEMON
	tristate "MCUmgr daemon support"
	default n

if MGMT_MCUMGR_DAEMON

config MGMT_MCUMGR_DAEMON_PROGNAME
	string "MCUmgr daemon name"
	default "mcumgr"

config MGMT_MCUMGR_DAEMON_PRIORITY
	int "MCUmgr daemon task priority"
	default 100

config MGMT_MCUMGR_DAEMON_STACKSIZE
	int "MCUmgr daemon stack size"
	default DEFAULT_TASK_STACKSIZE

endif # MGMT_MCUMGR_DAEMON

source "$APPSDIR/mgmt/mcumgr/mcumgr/mgmt/Kconfig"

source "$APPSDIR/mgmt/mcumgr/mcumgr/smp/Kconfig"

menu "Command Handlers"
source "$APPSDIR/mgmt/mcumgr/mcumgr/grp/Kconfig"
endmenu

menu "Transports and Transport Related Configuration Options"
source "$APPSDIR/mgmt/mcumgr/mcumgr/transport/Kconfig"
endmenu

endif # MGMT_MCUMGR
```

## system/mcumgr/Kconfig
```kconfig
#
# For a description of the syntax of this configuration file,
# see the file kconfig-language.txt in the NuttX tools repository.
#

menuconfig SYSTEM_MCUMGR
	tristate "MCUmgr support"
	default n
	depends on FSUTILS_ZCBOR
	---help---
		Enable support for MCUmgr

if SYSTEM_MCUMGR

endif # SYSTEM_MCUMGR
```
