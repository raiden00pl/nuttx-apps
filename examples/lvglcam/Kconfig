## examples/lvglcam/Kconfig
```kconfig
#
# For a description of the syntax of this configuration file,
# see the file kconfig-language.txt in the NuttX tools repository.
#

menuconfig EXAMPLES_LVGLCAM
	tristate "LVGL camera dashboard"
	default n
	depends on GRAPHICS_LVGL && VIDEO_STREAM && FB_OVERLAY_BLIT
	select NETUTILS_NETLIB if NET
	---help---
		LVGL dashboard with the live view of a V4L2 camera and live system,
		sensor and network data.  LVGL draws to the UI overlay.  The frames
		are captured into three frame overlays and blitted into the view
		overlay, a layer above the UI overlay that FBIOSET_DESTAREA places
		over the view, so LVGL never draws over the frames.  SIGINT or
		SIGTERM stops it.

if EXAMPLES_LVGLCAM

config EXAMPLES_LVGLCAM_PRIORITY
	int "lvglcam task priority"
	default 100
	---help---
		Priority of the LVGL task.  The camera and snapshot threads
		inherit it.

config EXAMPLES_LVGLCAM_STACKSIZE
	int "lvglcam stack size"
	default 16384
	---help---
		Stack size of the LVGL task.

config EXAMPLES_LVGLCAM_INPUT_DEVPATH
	string "Touchscreen device path"
	default "/dev/input0"
	depends on INPUT_TOUCHSCREEN
	---help---
		Touchscreen used as the LVGL pointer.

config EXAMPLES_LVGLCAM_VIDEO_DEVPATH
	string "Camera device path"
	default "/dev/video"
	---help---
		V4L2 capture device registered by the board.

config EXAMPLES_LVGLCAM_FB_DEVPATH
	string "Framebuffer device path"
	default "/dev/fb0"
	---help---
		Framebuffer with the UI, view and frame overlays.

config EXAMPLES_LVGLCAM_UI_OVERLAY
	int "UI overlay"
	default 0
	---help---
		RGB565 framebuffer overlay covering the display that LVGL draws
		to.

config EXAMPLES_LVGLCAM_VIEW_OVERLAY
	int "View overlay"
	default 1
	---help---
		RGB565 framebuffer overlay shown above the UI overlay that shows
		the frames.  It must support FBIOSET_DESTAREA.

config EXAMPLES_LVGLCAM_FRAME_OVERLAY
	int "First frame overlay"
	default 2
	---help---
		First of the three framebuffer overlays the frames are captured
		into.  Each must hold one frame without line padding and be a
		FBIOSET_BLIT source.

config EXAMPLES_LVGLCAM_WIDTH
	int "Camera view width"
	default 512
	range 8 2048
	---help---
		Width of the RGB565 frames requested from the camera, a multiple
		of 8.  The view and the data column must fit the display.

config EXAMPLES_LVGLCAM_HEIGHT
	int "Camera view height"
	default 384
	range 1 2048
	---help---
		Height of the RGB565 frames requested from the camera.

config EXAMPLES_LVGLCAM_ACCEL_DEVPATH
	string "Accelerometer uORB device path"
	default "/dev/uorb/sensor_accel0"
	depends on SENSORS
	---help---
		uORB accelerometer shown in the IMU card.

config EXAMPLES_LVGLCAM_NETDEV
	string "Network interface"
	default "eth0"
	depends on NET
	---help---
		Network interface shown in the network card.

config EXAMPLES_LVGLCAM_TOF
	bool "Depth card"
	default y
	---help---
		Show the 8x8 distances of a V4L2 Z16 depth camera, such as the
		VL53L5CX time-of-flight sensor.  Errors of the depth camera are
		shown on the card and do not stop the dashboard.

if EXAMPLES_LVGLCAM_TOF

config EXAMPLES_LVGLCAM_TOF_DEVPATH
	string "Depth camera device path"
	default "/dev/video1"

config EXAMPLES_LVGLCAM_TOF_FAR
	int "Far end of the colour scale (mm)"
	default 2000
	range 100 4000

endif # EXAMPLES_LVGLCAM_TOF

config EXAMPLES_LVGLCAM_SNAPDIR
	string "Snapshot directory"
	default "/mnt"
	---help---
		Directory where the snapshot button saves BMP pictures, named
		IMG_0001.BMP to IMG_9999.BMP.  Existing files are never
		overwritten.

endif # EXAMPLES_LVGLCAM
```

## netutils/s2opc/Kconfig
```kconfig
#
# For a description of the syntax of this configuration file,
# see the file kconfig-language.txt in the NuttX tools repository.
#

menuconfig NETUTILS_S2OPC
	bool "S2OPC OPC UA toolkit"
	default n
	depends on CRYPTO_MBEDTLS
	depends on LIBC_NETDB && PTHREAD_MUTEX_TYPES
	depends on NET_TCP && NET_UDP
	depends on NET_SOCKOPTS && NET_TCP_KEEPALIVE
	depends on DEV_URANDOM
	depends on RR_INTERVAL > 0
	depends on NET_BINDTODEVICE
	---help---
		Enable the S2OPC OPC UA client/server and UDP PubSub toolkit.  The
		selected S2OPC release is downloaded when the applications tree is
		configured.  A cryptographically suitable random source is required
		when secure OPC UA policies are used.  Certificate validation also
		requires a correctly initialized system clock.  A round-robin
		timeslice is required for normal S2OPC worker threads.

if NETUTILS_S2OPC

config S2OPC_VERSION
	string "S2OPC version"
	default "1.7.3"

config S2OPC_THREAD_STACKSIZE
	int "S2OPC worker thread stack size"
	default 32768
	range PTHREAD_STACK_MIN 1048576
	---help---
		Stack size assigned to worker threads created by S2OPC.  Secure OPC
		UA processing needs considerably more stack than small NuttX tasks.

config S2OPC_XML_LOADERS
	bool "Enable XML configuration loaders"
	default n
	depends on ALLOW_MIT_COMPONENTS
	depends on LIB_EXPAT
	---help---
		Enable the S2OPC client, server, user, address-space, and PubSub XML
		loaders.  This adds the Expat XML parser dependency.  Leave this
		disabled when configuration and address-space data are constructed
		with the S2OPC C APIs or generated as C source.

config S2OPC_NODE_MANAGEMENT
	bool "Enable OPC UA Node Management services"
	default n
	---help---
		Enable the AddNodes and DeleteNodes services.  The configured server
		address space must be dynamically allocated for these services to
		modify it.

config S2OPC_NODE_ADD_OPTIONAL
	bool "Add optional child nodes with Node Management"
	default n
	depends on S2OPC_NODE_MANAGEMENT
	---help---
		Add optional child nodes declared by a type when AddNodes creates an
		object, variable, or method node.  Mandatory child nodes are added
		regardless of this option.

config S2OPC_HISTORY_READ
	bool "Enable external HistoryRead Raw service"
	default n
	---help---
		Enable S2OPC's HistoryRead Raw service.  The application must provide
		the external history-read callback and its underlying history store.

config S2OPC_EVENT_MANAGEMENT
	bool "Enable OPC UA Events"
	default n
	---help---
		Enable server event creation, triggering, and event monitored items.
		The configured address space must contain the required event types.

config S2OPC_AUDITING
	bool "Enable OPC UA security auditing"
	default n
	depends on S2OPC_EVENT_MANAGEMENT
	---help---
		Enable S2OPC's auditing support.  S2OPC 1.7.3 limits auditing to
		security audit event types and requires OPC UA Events.

config S2OPC_MQTT
	bool "Enable MQTT PubSub transport"
	default n
	depends on LIB_MQTT5
	---help---
		Enable the S2OPC MQTT PubSub transport using the Eclipse Paho MQTT
		Async library packaged by NuttX.

config S2OPC_ETHERNET
	bool "Enable raw Ethernet PubSub transport"
	default n
	depends on NET_PKT
	depends on NET_MCASTGROUP
	depends on NET_PKTPROTO_OPTIONS
	---help---
		Enable UADP PubSub over raw Ethernet packet sockets.  Multicast
		reception requires a network driver that implements multicast MAC
		filtering.  The NuttX packet-socket implementation requires an
		interface name and a destination multicast MAC address.  A combined
		publisher/subscriber needs at least two packet-socket connections.

endif # NETUTILS_S2OPC
```
